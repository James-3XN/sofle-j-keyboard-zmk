## dts/bindings/behaviors/zmk,behavior-battery-pct.yaml
```yaml
# SPDX-License-Identifier: MIT

description: Show or hide the battery percentage next to the battery icon on both screens

compatible: "zmk,behavior-battery-pct"

include: zero_param.yaml
```

## dts/bindings/behaviors/zmk,behavior-display-invert.yaml
```yaml
# SPDX-License-Identifier: MIT

description: Toggle the nice!view colours between black-on-white and white-on-black

compatible: "zmk,behavior-display-invert"

include: zero_param.yaml
```

## dts/bindings/behaviors/zmk,behavior-underglow-dim-step.yaml
```yaml
# SPDX-License-Identifier: MIT

description: Step the underglow brightness through a fixed table that is finer at the low end

compatible: "zmk,behavior-underglow-dim-step"

include: zero_param.yaml

properties:
  brighter:
    type: boolean
    description: Step up instead of down
```

## dts/bindings/behaviors/zmk,behavior-version-toggle.yaml
```yaml
# SPDX-License-Identifier: MIT

description: Show the firmware version in place of the screens' bottom labels (toggle)

compatible: "zmk,behavior-version-toggle"

include: zero_param.yaml
```
